## CMakeLists.txt
```
cmake_minimum_required(VERSION 3.20.0)
find_package(Zephyr REQUIRED HINTS $ENV{ZEPHYR_BASE})
project(ZephyrApp)

target_sources(app PRIVATE 

src/main.c
src/custom_allocation.c
src/file_converter.c
)

target_include_directories(app PRIVATE src)
```

## prj.conf
```kconfig
CONFIG_FILE_SYSTEM=y
CONFIG_FS_LITTLEFS_BLK_DEV=y
```

## boards/nucleo_l476rg.overlay
```dts
/* / {
    chosen {
        main,display = &st7735r;
    };

    mipi_dbi {
        compatible = "zephyr,mipi-dbi-spi";
        spi-dev = <&spi1>;
        dc-gpios = <&gpioa 8 GPIO_ACTIVE_HIGH>;
        reset-gpios = <&gpioc 4 GPIO_ACTIVE_LOW>;
        #address-cells = <1>;
        #size-cells = <0>;
        st7735r: st7735r@0 {
            compatible = "sitronix,st7735r";
            reg = <0>;
            mipi-max-frequency = <1000000>;
            mipi-mode = "MIPI_DBI_MODE_SPI_4WIRE";
            rgb-is-inverted;
            width = <128>;
            height = <128>;
            x-offset = <2>;
            y-offset = <1>;
            madctl = <0x00>;
            colmod = <0x55>;
            vmctr1 = <0x0e>;
            invctr = <0x07>;
            pwctr1 = [a2 02 84];
            pwctr2 = [c5];
            pwctr3 = [0a 00];
            pwctr4 = [8a 2a];
            pwctr5 = [8a ee];
            frmctr1 = [01 2c 2d];
            frmctr2 = [01 2c 2d];
            frmctr3 = [01 2c 2d 01 2c 2d];
            caset = [00 00 00 7f];
            raset = [00 00 00 7f];
            gamctrp1 = [02 1c 07 12 37 32 29 2d 29 25 2b 39 00 01 03 10];
            gamctrn1 = [03 1d 07 06 2e 2c 29 2d 2e 2e 37 3f 00 00 02 10];
        };
    };
};

#include <zephyr/dt-bindings/dma/stm32_dma.h>

&dma1 {
    status = "okay";
};

&spi1 {
    dmas = <&dma1 3 1 (STM32_DMA_MEMORY_TO_PERIPH | STM32_DMA_PERIPH_NO_INC |
                       STM32_DMA_MEM_INC | STM32_DMA_PERIPH_8BITS |
                       STM32_DMA_MEM_8BITS | STM32_DMA_PRIORITY_HIGH)>,
           <&dma1 2 1 (STM32_DMA_PERIPH_TO_MEMORY | STM32_DMA_PERIPH_NO_INC |
                       STM32_DMA_MEM_INC | STM32_DMA_PERIPH_8BITS |
                       STM32_DMA_MEM_8BITS | STM32_DMA_PRIORITY_HIGH)>;
    dma-names = "tx", "rx";
}; */
```

## src/main.c
```c
#include <stdint.h>
#include <string.h>
#include <zephyr/device.h>
#include <zephyr/kernel.h>

#include "custom_allocation.h"
#include "file_converter.h"

int main(void)
{

    printk("Custom allocator initialized.\n");

    int *my_array = (int *)my_malloc(5 * sizeof(int));

    if (my_array == NULL)
    {
        printk("Failed to allocate memory!\n");
        return -1;
    }

    for (int i = 0; i < 5; i++)
    {
        my_array[i] = i * 10;
    }

    int *new_ptr = (int *)my_realloc(my_array, 10 * sizeof(int));
    if (new_ptr != NULL)
    {
        my_array = new_ptr;
    }

    my_free(my_array);
    printk("Memory freed.\n");
    return 0;
}
```

## src/allocation_default.c
```c
#include <stdint.h>
#include <string.h>
// Idk how much heap size actually needs to be, but 1KB should be enough for testing
#define HEAP_SIZE 1024
#define MALLOC_ALIGNMENT sizeof(void *)

static uint8_t heap[HEAP_SIZE];

typedef struct block_header_t
{
    size_t size;
    struct block_header_t *next;
    uint8_t is_free;
    uint8_t reserved[3];
} block_header_t;

static block_header_t *head = (block_header_t *)heap;

void my_alloc_init(void)
{
    // printk("Initializing custom allocator with heap size: %d bytes\n", HEAP_SIZE);
    // printk("Allocation alignment: %d bytes\n", MALLOC_ALIGNMENT);
    head->size = HEAP_SIZE - sizeof(block_header_t);
    head->is_free = 1;
    head->next = NULL;
}

void *my_malloc(size_t size)
{
    size = (size + MALLOC_ALIGNMENT - 1) & ~(MALLOC_ALIGNMENT - 1);
    block_header_t *current = head;

    while (current)
    {
        if (current->is_free && current->size >= size)
        {
            if (current->size > size + sizeof(block_header_t) + MALLOC_ALIGNMENT)
            {
                block_header_t *new_block = (block_header_t *)((uint8_t *)current + sizeof(block_header_t) + size);
                new_block->size = current->size - size - sizeof(block_header_t);
                new_block->is_free = 1;
                new_block->next = current->next;

                current->size = size;
                current->next = new_block;
            }
            current->is_free = 0;
            return (void *)(current + 1);
        }
        current = current->next;
    }
    return NULL;
}

void my_free(void *ptr)
{
    if (!ptr)
    {
        return;
    }
    block_header_t *header = (block_header_t *)ptr - 1;
    header->is_free = 1;

    if (header->next && header->next->is_free)
    {
        header->size += sizeof(block_header_t) + header->next->size;
        header->next = header->next->next;
    }
}

/**
 * @note Here can be error cause of non-enough size for duplication
 */
void *my_realloc(void *ptr, size_t size)
{
    if (!ptr)
    {
        return my_malloc(size);
    }
    block_header_t *header = (block_header_t *)ptr - 1;
    if (header->size >= size)
    {
        return ptr;
    }

    void *new_ptr = my_malloc(size);
    if (new_ptr)
    {
        memcpy(new_ptr, ptr, header->size);
        my_free(ptr);
    }
    return new_ptr;
}
```

## src/custom_allocation.c
```c
#include <stddef.h>
#include <stdint.h>
#include <string.h>
#include <zephyr/kernel.h>

#include "custom_allocation.h"

#define APP_HEAP_SIZE 1024
//We can define as many heaps as we want
K_HEAP_DEFINE(app_heap, APP_HEAP_SIZE);

typedef struct alloc_header
{
    size_t size;
} alloc_header_t;

//Helper for multiplication
static int multiply_size(size_t n, size_t size, size_t *out)
{
    if (n != 0 && size > SIZE_MAX / n)
    {
        return -1;
    }

    *out = n * size;
    return 0;
}

void *my_malloc(size_t size)
{
    if (size == 0)
    {
        return NULL;
    }

    //Allocation in specific heap, also immediately throws NULL if allocation fails
    alloc_header_t *head = k_heap_alloc(&app_heap, sizeof(*head) + size, K_NO_WAIT);
    if (!head)
    {
        //here head = NULL, so we can just return it
        return NULL;
    }

    head->size = size;
    return (void *)(head + 1);
}

void *my_calloc(size_t n, size_t size)
{
    size_t total;

    if (multiply_size(n, size, &total) < 0)
    {
        return NULL;
    }

    void *ptr = my_malloc(total);
    if (!ptr)
    {
        return NULL;
    }

    memset(ptr, 0, total);
    return ptr;
}

void my_free(void *ptr)
{
    if (!ptr)
    {
        return;
    }

    alloc_header_t *head = ((alloc_header_t *)ptr) - 1;
    k_heap_free(&app_heap, head);
}

void *my_realloc(void *ptr, size_t size)
{
    if (!ptr)
    {
        return my_malloc(size);
    }

    if (size == 0)
    {
        my_free(ptr);
        return NULL;
    }

    alloc_header_t *old_head = ((alloc_header_t *)ptr) - 1;
    void *new_ptr = my_malloc(size);
    if (!new_ptr)
    {
        return NULL;
    }

    size_t copy_size = old_head->size < size ? old_head->size : size;
    memcpy(new_ptr, ptr, copy_size);
    my_free(ptr);

    return new_ptr;
}
```

## src/custom_allocation.h
```c
#ifndef CUSTOM_ALLOCATION_H
#define CUSTOM_ALLOCATION_H

#include <stdint.h>
#include <stddef.h>

void my_alloc_init(void);

void *my_malloc(size_t size);
void *my_calloc(size_t n, size_t size);
void my_free(void *ptr);
void *my_realloc(void *ptr, size_t size);

#endif // CUSTOM_ALLOCATION_H
```

## src/endian_converter.c
```c
#include <stdint.h>
#include <stdio.h>

uint16_t swap_16(uint16_t value)
{
    return (value >> 8) | (value << 8);
}

uint16_t bytes_to_le16(uint8_t *bytes)
{
    return (uint16_t)bytes[0] | ((uint16_t)bytes[1] << 8);
}

uint16_t bytes_to_be16(uint8_t *bytes)
{
    return ((uint16_t)bytes[0] << 8) | (uint16_t)bytes[1];
}

void le16_to_bytes(uint16_t value, uint8_t *bytes)
{
    bytes[0] = value & 0xFF;        
    bytes[1] = (value >> 8) & 0xFF; 
}

void be16_to_bytes(uint16_t value, uint8_t *bytes)
{
    bytes[0] = (value >> 8) & 0xFF; 
    bytes[1] = value & 0xFF;       
}

uint32_t swap_32(uint32_t value)
{
    return ((value) << 24) |
           ((value & 0xFF00) << 8)  |
           ((value & 0xFF0000) >> 8)  |
           (value  >> 24);
}

uint32_t bytes_to_le32(uint8_t *bytes)
{
    return (uint32_t)bytes[0]       |
           ((uint32_t)bytes[1] << 8) |
           ((uint32_t)bytes[2] << 16)|
           ((uint32_t)bytes[3] << 24);
}

uint32_t bytes_to_be32(uint8_t *bytes)
{
    return ((uint32_t)bytes[0] << 24)|
           ((uint32_t)bytes[1] << 16)|
           ((uint32_t)bytes[2] << 8) |
           (uint32_t)bytes[3];
}

void le32_to_bytes(uint32_t value, uint8_t *bytes)
{
    bytes[0] = value & 0xFF;
    bytes[1] = (value >> 8) & 0xFF;
    bytes[2] = (value >> 16) & 0xFF;
    bytes[3] = (value >> 24);
}

void be32_to_bytes(uint32_t value, uint8_t *bytes)
{
    bytes[0] = (value >> 24);
    bytes[1] = (value >> 16) & 0xFF;
    bytes[2] = (value >> 8) & 0xFF;
    bytes[3] = value & 0xFF;
}

void print_bytes(const char *label, uint8_t *bytes, int count)
{
    printf("%s: ", label);
    for (int i = 0; i < count; i++) {
        printf("%02X ", bytes[i]);
    }
    printf("\n");
}

//Generated tests
int main(void)
{
    printf("=== 16-BIT CONVERSION ===\n");
    uint16_t val16 = 0x1234;
    printf("Original value: 0x%04X\n", val16);
    
    uint8_t bytes16[2];
    le16_to_bytes(val16, bytes16);
    print_bytes("Little-endian bytes", bytes16, 2);
    
    be16_to_bytes(val16, bytes16);
    print_bytes("Big-endian bytes", bytes16, 2);
    
    uint16_t swapped16 = swap_16(val16);
    printf("Swapped: 0x%04X\n\n", swapped16);
    
    printf("=== 32-BIT CONVERSION ===\n");
    uint32_t val32 = 0x12345678;
    printf("Original value: 0x%08X\n", val32);
    
    uint8_t bytes32[4];
    le32_to_bytes(val32, bytes32);
    print_bytes("Little-endian bytes", bytes32, 4);
    
    be32_to_bytes(val32, bytes32);
    print_bytes("Big-endian bytes", bytes32, 4);
    
    uint32_t swapped32 = swap_32(val32);
    printf("Swapped: 0x%08X\n\n", swapped32);
    
    printf("=== READING FROM BUFFER ===\n");
    uint8_t buffer_le[] = {0x78, 0x56, 0x34, 0x12};
    uint8_t buffer_be[] = {0x12, 0x34, 0x56, 0x78};
    
    printf("LE buffer: ");
    print_bytes("", buffer_le, 4);
    printf("Read as LE: 0x%08X\n", bytes_to_le32(buffer_le));
    
    printf("BE buffer: ");
    print_bytes("", buffer_be, 4);
    printf("Read as BE: 0x%08X\n", bytes_to_be32(buffer_be));
    
    return 0;
}
```

## src/file_converter.c
```c
#include <ctype.h>
#include <errno.h>
#include <stdint.h>

#include <zephyr/fs/fs.h>
#include <zephyr/kernel.h>

static int copy_file_bytes(const char *src_path, const char *dst_path)
{
    struct fs_file_t source;
    struct fs_file_t destination;
    uint8_t buffer[128];

    fs_file_t_init(&source);
    fs_file_t_init(&destination);

    int rc = fs_open(&source, src_path, FS_O_READ);
    if (rc < 0)
    {
        return rc;
    }

    rc = fs_open(&destination, dst_path, FS_O_CREATE | FS_O_WRITE | FS_O_TRUNC);
    if (rc < 0)
    {
        fs_close(&source);
        return rc;
    }

    while (1)
    {
        size_t read_bytes = fs_read(&source, buffer, sizeof(buffer));
        if (read_bytes < 0)
        {
            rc = (int)read_bytes;
            break;
        }
        if (read_bytes == 0)
        {
            rc = 0;
            break;
        }

        ssize_t offset = 0;
        while (offset < read_bytes)
        {
            ssize_t wrote = fs_write(&destination, &buffer[offset], (size_t)(read_bytes - offset));
            if (wrote < 0)
            {
                rc = (int)wrote;
                break;
            }
            if (wrote == 0)
            {
                rc = -EIO;
                break;
            }
            offset += wrote;
        }

        if (rc < 0)
        {
            break;
        }
    }

    fs_close(&destination);
    fs_close(&source);
    return rc;
}

int c_file_to_binary(const char *c_path, const char *bin_path)
{
    return copy_file_bytes(c_path, bin_path);
}

static inline char nibble_to_hex(uint8_t nibble)
{
    return (nibble < 10U) ? (char)('0' + nibble) : (char)('A' + (nibble - 10U));
}

int binary_to_hex(const char *bin_path, const char *hex_path)
{
    struct fs_file_t in;
    struct fs_file_t out;
    uint8_t byte;
    char pair[2];

    fs_file_t_init(&in);
    fs_file_t_init(&out);

    int rc = fs_open(&in, bin_path, FS_O_READ);
    if (rc < 0)
    {
        return rc;
    }

    rc = fs_open(&out, hex_path, FS_O_CREATE | FS_O_WRITE | FS_O_TRUNC);
    if (rc < 0)
    {
        fs_close(&in);
        return rc;
    }

    while (1)
    {
        ssize_t read_bytes = fs_read(&in, &byte, 1);
        if (read_bytes < 0)
        {
            rc = (int)read_bytes;
            break;
        }
        if (read_bytes == 0)
        {
            rc = 0;
            break;
        }

        pair[0] = nibble_to_hex((uint8_t)((byte >> 4) & 0x0F));
        pair[1] = nibble_to_hex((uint8_t)(byte & 0x0F));

        ssize_t wrote = fs_write(&out, pair, sizeof(pair));
        if (wrote < 0)
        {
            rc = (int)wrote;
            break;
        }
        if (wrote != (ssize_t)sizeof(pair))
        {
            rc = -EIO;
            break;
        }
    }

    fs_close(&out);
    fs_close(&in);
    return rc;
}

static int hex_nibble_value(int ch)
{
    if (ch >= '0' && ch <= '9')
    {
        return ch - '0';
    }
    if (ch >= 'A' && ch <= 'F')
    {
        return ch - 'A' + 10;
    }
    if (ch >= 'a' && ch <= 'f')
    {
        return ch - 'a' + 10;
    }
    return -1;
}

int hex_to_binary(const char *hex_path, const char *bin_path)
{
    struct fs_file_t in;
    struct fs_file_t out;
    int high_nibble = -1;

    fs_file_t_init(&in);
    fs_file_t_init(&out);

    int rc = fs_open(&in, hex_path, FS_O_READ);
    if (rc < 0)
    {
        return rc;
    }

    rc = fs_open(&out, bin_path, FS_O_CREATE | FS_O_WRITE | FS_O_TRUNC);
    if (rc < 0)
    {
        fs_close(&in);
        return rc;
    }

    while (1)
    {
        uint8_t ch;
        ssize_t read_bytes = fs_read(&in, &ch, 1);
        if (read_bytes < 0)
        {
            rc = (int)read_bytes;
            break;
        }
        if (read_bytes == 0)
        {
            rc = (high_nibble < 0) ? 0 : -EINVAL;
            break;
        }

        if (isspace((unsigned char)ch))
        {
            continue;
        }

        int nibble = hex_nibble_value((int)ch);
        if (nibble < 0)
        {
            rc = -EINVAL;
            break;
        }

        if (high_nibble < 0)
        {
            high_nibble = nibble;
            continue;
        }

        uint8_t byte = (uint8_t)((high_nibble << 4) | nibble);
        ssize_t wrote = fs_write(&out, &byte, 1);
        if (wrote < 0)
        {
            rc = (int)wrote;
            break;
        }
        if (wrote != 1)
        {
            rc = -EIO;
            break;
        }

        high_nibble = -1;
    }

    fs_close(&out);
    fs_close(&in);
    return rc;
}

int binary_to_c_file(const char *bin_path, const char *c_path)
{
    return copy_file_bytes(bin_path, c_path);
}

int printk_file_text(const char *path)
{
    struct fs_file_t file;
    uint8_t buffer[128];

    fs_file_t_init(&file);

    int rc = fs_open(&file, path, FS_O_READ);
    if (rc < 0)
    {
        return rc;
    }

    while (1)
    {
        ssize_t read_bytes = fs_read(&file, buffer, sizeof(buffer) - 1U);
        if (read_bytes < 0)
        {
            rc = (int)read_bytes;
            break;
        }
        if (read_bytes == 0)
        {
            rc = 0;
            break;
        }

        buffer[read_bytes] = '\0';
        printk("%s", buffer);
    }

    fs_close(&file);
    return rc;
}
```

## src/file_converter.h
```c
#ifndef FILE_CONVERTER_H
#define FILE_CONVERTER_H

int c_file_to_binary(const char *c_path, const char *bin_path);
int binary_to_hex(const char *bin_path, const char *hex_path);
int hex_to_binary(const char *hex_path, const char *bin_path);
int binary_to_c_file(const char *bin_path, const char *c_path);
int printk_file_text(const char *path);

#endif // FILE_CONVERTER_H
```
